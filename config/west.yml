## config/west.yml
```yaml
manifest:
  remotes:
    - name: zmkfirmware
      url-base: https://github.com/zmkfirmware
  projects:
    - name: zmk
      remote: zmkfirmware
      revision: 73fd4b9230bec4333fc3ecc74e455af78016f0e2
      import: app/west.yml
  self:
    path: config
```
